## Kconfig
```kconfig
config GINO_INSTALL_DIR
  string "Installation directory for Gino"
  default "./install"

config NOELLE_INSTALL_DIR
  string "Pre-existing installation of Noelle. If empty, Noelle will be installed anew"
  default ""

config GINO_TOOLS
  bool "Install all the tools build on top of Gino"
  default y

config GINO_BUILD_TYPE
  string "Set build type for Gino"
  default "Debug"
```
